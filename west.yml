## west.yml
```yaml
# SPDX-License-Identifier: Apache-2.0

manifest:
  self:
    path: zephyr-optee-test

  remotes:
    - name: oleksiimoisieiev
      url-base: https://github.com/oleksiimoisieiev

    - name: zephyr
      url-base: https://github.com/zephyrproject-rtos

  projects:
    - name: zephyr
      remote: oleksiimoisieiev
      revision: optee_driver_sq
      west-commands: scripts/west-commands.yml

    - name: zephyr-optee-client
      remote: oleksiimoisieiev
      revision: client_main

    - name: littlefs
      remote: zephyr
      path: modules/fs/littlefs
      groups:
        - fs
      revision: ca583fd297ceb48bced3c2548600dc615d67af24
```
